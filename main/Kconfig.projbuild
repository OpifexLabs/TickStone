## main/Kconfig.projbuild
```kconfig
menu "TickStone"

config TICKSTONE_STORAGE_SELF_TEST
    bool "Run destructive TickStone NVS storage self-test on boot"
    default n
    help
        Runs a boot-time diagnostic that erases the TickStone NVS namespace,
        writes logs and an active session, loads them back, and halts after
        reporting PASS or FAIL over serial. Keep this disabled for normal use.

endmenu
```

## sdkconfig.defaults
```kconfig
CONFIG_IDF_TARGET="esp32c3"
CONFIG_PARTITION_TABLE_CUSTOM=y
CONFIG_PARTITION_TABLE_CUSTOM_FILENAME="partitions.csv"
CONFIG_PM_ENABLE=y
CONFIG_FREERTOS_USE_TICKLESS_IDLE=y
CONFIG_ESPTOOLPY_FLASHSIZE_4MB=y
```
